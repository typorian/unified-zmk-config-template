## west.yml
```yaml
manifest:
  remotes:
    - name: zmkfirmware
      url-base: https://github.com/zmkfirmware
    - name: chrisandreae
      url-base: https://github.com/chrisandreae
  projects:
    - name: zmk
      remote: zmkfirmware
      revision: main
      import: app/west.yml
#    - name: zmk
#      remote: chrisandreae
#      revision: boot-protocol
#      import: app/west.yml
  self:
    path: config
```
